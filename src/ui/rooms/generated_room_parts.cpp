/** generated_room_parts.cpp - generated by scripts/build_core2_room_parts.py. */
#include "generated_room_parts.h"
#include "../menu_pig_render.h"
#include <pgmspace.h>

namespace MenuPig {
namespace RoomParts {
namespace {

using namespace MenuPigRender;
static constexpr int16_t kGrid = 4;

struct Run {
    uint8_t x, y, length, height, tone;
};

struct Part {
    const Run* runs;
    uint16_t runCount;
    int16_t x, y;
    uint8_t parallax, foreground, accent;
};

static const Run kLabConsole[] PROGMEM = {
    {5, 1, 1, 1, 1},
    {6, 1, 8, 1, 2},
    {14, 1, 1, 1, 1},
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    {30, 21, 3, 1, 1},
};

static const Run kLabServer[] PROGMEM = {
    {7, 14, 1, 1, 2},
    {8, 14, 2, 1, 1},
    {10, 14, 1, 1, 2},
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    {1, 26, 1, 1, 1},
};

static const Run kLabCables[] PROGMEM = {
    {1, 2, 6, 1, 2},
    {7, 2, 2, 2, 1},
    {13, 2, 1, 1, 2},
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    {4, 15, 13, 2, 1},
};

static const Run kApartmentSofa[] PROGMEM = {
    {4, 1, 6, 1, 1},
    {10, 1, 4, 1, 2},
    {14, 1, 1, 1, 1},
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    {5, 16, 3, 1, 1},
};

static const Run kApartmentWindow[] PROGMEM = {
    {12, 1, 16, 1, 1},
    {10, 2, 4, 2, 1},
    {14, 2, 13, 1, 2},
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    {14, 22, 15, 1, 1},
};

static const Run kApartmentLamp[] PROGMEM = {
    {4, 1, 1, 4, 1},
    {5, 1, 2, 2, 2},
    {7, 1, 2, 2, 1},
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    {7, 16, 2, 1, 1},
};

static const Run kApartmentTvPipes[] PROGMEM = {
    {11, 3, 4, 1, 1},
    {15, 3, 1, 8, 2},
    {16, 3, 2, 6, 1},
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    {10, 22, 6, 1, 1},
};

static const Run kRamenCounter[] PROGMEM = {
    {10, 1, 1, 1, 1},
    {11, 1, 8, 1, 2},
    {19, 1, 1, 1, 1},
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    {8, 20, 4, 1, 1},
};

static const Run kRamenPod[] PROGMEM = {
    {2, 2, 11, 1, 2},
    {13, 2, 1, 1, 3},
    {14, 2, 8, 1, 2},
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    {1, 16, 25, 1, 1},
};

static const Run kRamenSignVent[] PROGMEM = {
    {3, 1, 1, 1, 1},
    {4, 1, 1, 1, 2},
    {5, 1, 2, 1, 1},
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    {5, 12, 12, 1, 1},
};

static const Run kRooftopAntenna[] PROGMEM = {
    {8, 1, 1, 1, 2},
    {9, 1, 1, 6, 1},
    {7, 2, 1, 5, 1},
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    {3, 43, 13, 1, 1},
};

static const Run kRooftopDish[] PROGMEM = {
    {3, 1, 1, 1, 2},
    {4, 1, 1, 1, 3},
    {5, 1, 1, 1, 1},
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    {4, 20, 11, 1, 1},
};

static const Run kRooftopShack[] PROGMEM = {
    {15, 10, 2, 1, 2},
    {17, 10, 1, 1, 1},
    {14, 11, 1, 1, 1},
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    {11, 35, 9, 1, 1},
};

static const Run kRooftopRail[] PROGMEM = {
    {8, 1, 17, 1, 2},
    {25, 1, 1, 1, 1},
    {8, 2, 18, 1, 1},
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    {21, 8, 2, 1, 1},
};

static const Run kBarTerminal[] PROGMEM = {
    {1, 3, 1, 4, 1},
    {2, 3, 1, 4, 2},
    {3, 3, 1, 4, 1},
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    {6, 26, 3, 1, 1},
};

static const Run kBarCounter[] PROGMEM = {
    {5, 4, 3, 2, 1},
    {5, 6, 1, 1, 1},
    {6, 6, 1, 1, 2},
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    {3, 27, 26, 1, 1},
};

static const Run kBarBooth[] PROGMEM = {
    {5, 3, 13, 1, 2},
    {18, 3, 10, 1, 1},
    {5, 4, 1, 1, 2},
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    {16, 24, 8, 1, 1},
};

static const Run kBarSign[] PROGMEM = {
    {28, 1, 2, 2, 1},
    {14, 2, 9, 1, 2},
    {12, 3, 1, 4, 1},
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    {21, 11, 9, 1, 1},
};

static const Part kParts[] = {
    {kLabConsole, 58, 0, 108, 2, 0, 1},
    {kLabServer, 11, 174, 100, 2, 0, 1},
    {kLabCables, 29, 88, 24, 1, 0, 0},
    {kApartmentSofa, 82, 8, 142, 2, 0, 0},
    {kApartmentWindow, 21, 132, 38, 1, 0, 3},
    {kApartmentLamp, 11, 112, 138, 2, 0, 2},
    {kApartmentTvPipes, 48, 36, 62, 1, 0, 1},
    {kRamenCounter, 49, 8, 130, 2, 0, 2},
    {kRamenPod, 69, 188, 142, 2, 0, 1},
    {kRamenSignVent, 16, 108, 50, 1, 0, 3},
    {kRooftopAntenna, 95, 4, 34, 2, 0, 4},
    {kRooftopDish, 70, 56, 94, 2, 0, 0},
    {kRooftopShack, 95, 96, 66, 1, 0, 2},
    {kRooftopRail, 25, 180, 178, 3, 1, 0},
    {kBarTerminal, 30, 4, 52, 2, 0, 1},
    {kBarCounter, 68, 72, 84, 2, 0, 2},
    {kBarBooth, 53, 196, 114, 2, 0, 0},
    {kBarSign, 42, 104, 24, 1, 0, 3},
};
static constexpr uint8_t kRoomPartOffsets[] = {
    0, 3, 7, 10, 14, 18,
};

static uint16_t toneColor(uint8_t tone, uint8_t accent) {
    if (tone == 1) return RP::DEEP;
    if (tone == 2) return RP::D_STRUCT;
    if (tone == 3) return RP::WALL_MID;
    if (accent == 1) return RP::CRT;
    if (accent == 2) return RP::WARM;
    if (accent == 3) return RP::NEON;
    if (accent == 4) return RP::LED;
    return RP::SOFT;
}

static void drawPart(M5Canvas& canvas, const Part& part, int16_t dx) {
    for (uint16_t i = 0; i < part.runCount; ++i) {
        const Run* run = part.runs + i;
        uint8_t x = pgm_read_byte(&run->x);
        uint8_t y = pgm_read_byte(&run->y);
        uint8_t length = pgm_read_byte(&run->length);
        uint8_t height = pgm_read_byte(&run->height);
        uint8_t tone = pgm_read_byte(&run->tone);
        canvas.fillRect(part.x + dx + x * kGrid, part.y + y * kGrid,
                        length * kGrid, height * kGrid, toneColor(tone, part.accent));
    }
}

static int16_t offsetFor(const Part& part, int16_t farDx, int16_t midDx, int16_t nearDx) {
    if (part.parallax == 1) return farDx;
    if (part.parallax == 2) return midDx;
    if (part.parallax == 3) return nearDx;
    return 0;
}

static void drawLayer(M5Canvas& canvas, uint8_t room, bool foreground,
                      int16_t farDx, int16_t midDx, int16_t nearDx) {
    if (room >= 5) return;
    uint8_t begin = kRoomPartOffsets[room];
    uint8_t end = kRoomPartOffsets[room + 1];
    for (uint8_t i = begin; i < end; ++i) {
        const Part& part = kParts[i];
        if ((part.foreground != 0) != foreground) continue;
        drawPart(canvas, part, offsetFor(part, farDx, midDx, nearDx));
    }
}

}  // namespace

void drawBackground(M5Canvas& canvas, uint8_t room, int16_t farDx, int16_t midDx) {
    drawLayer(canvas, room, false, farDx, midDx, 0);
}

void drawForeground(M5Canvas& canvas, uint8_t room, int16_t nearDx) {
    drawLayer(canvas, room, true, 0, 0, nearDx);
}

}  // namespace RoomParts
}  // namespace MenuPig
